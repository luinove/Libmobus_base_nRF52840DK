## CMakeLists.txt
```
# SPDX-License-Identifier: Apache-2.0

cmake_minimum_required(VERSION 3.20.0)

find_package(Zephyr REQUIRED HINTS $ENV{ZEPHYR_BASE})
project(my_modbus_rtu_client)

target_include_directories(app PRIVATE src/libmodbus)
target_sources(app PRIVATE src/libmodbus/modbus.c)
# target_sources(app PRIVATE src/libmodbus/errno.c)
target_sources(app PRIVATE src/libmodbus/modbus-data.c)
target_sources(app PRIVATE src/libmodbus/modbus-st-rtu.c)
target_sources(app PRIVATE src/libmodbus/uart_device.c)

target_sources(app PRIVATE src/main.c)
# target_sources(app PRIVATE src/libmodbus/)
```

## prj.conf
```kconfig
CONFIG_LOG=y
CONFIG_ENTROPY_GENERATOR=y

CONFIG_LOG_BACKEND_RTT=y

CONFIG_UART_INTERRUPT_DRIVEN=y
CONFIG_UART_LINE_CTRL=n

CONFIG_TIMING_FUNCTIONS=y
```

## app.overlay
```dts
/*
 * Copyright (c) 2020 Phytec Messtechnik GmbH
 *
 * SPDX-License-Identifier: Apache-2.0
 */
 / {
	/*
	* In some default configurations within the nRF Connect SDK,
	* e.g. on nRF52840, the chosen zephyr,entropy node is &cryptocell.
	* This devicetree overlay ensures that default is overridden wherever it
	* is set, as this application uses the RNG node for entropy exclusively.
	*/
	chosen {
		zephyr,entropy = &rng;
		zephyr,modbus = &uart1;
	};
};
&uart0 {
	status = "okay";
	// interrupts = <2 NRF_DEFAULT_IRQ_PRIORITY>;
	current-speed = <115200>;
};

&uart1 {
	status = "okay";
	current-speed = <9600>;
};

// &uart1_default {
// 	group1 {
// 		psels = <NRF_PSEL(UART_RX, 1, 7)>;
// 	};

// 	group2 {
// 		psels = <NRF_PSEL(UART_TX, 1, 10)>;
// 	};
// };
```

## src/main.c
```c
#include <zephyr/kernel.h>
#include <zephyr/sys/util.h>
#include <zephyr/drivers/gpio.h>

#include <zephyr/logging/log.h>
#include "libmodbus/modbus.h"
#include "libmodbus/uart_device.h"
LOG_MODULE_REGISTER(main, LOG_LEVEL_DBG);

int main(void)
{
	modbus_t *ctx;
	int rc;
	uint16_t temp[1];

	ctx = modbus_new_st_rtu("uart1", 9600, 'N', 8, 1);
	modbus_set_slave(ctx, 1);

	rc = modbus_connect(ctx);
	if(rc == 1)
	{
		modbus_free(ctx);
	}
	
	rc = modbus_read_registers(ctx, 0x06, 1, temp); 
	LOG_DBG("rc:%d;temp06 :%d", rc,  temp[0]);

	rc = modbus_read_registers(ctx, 0x09, 1, temp); 
	LOG_DBG("rc:%d;temp09 :%d", rc,  temp[0]);

	/* For RTU */
	modbus_close(ctx);
	modbus_free(ctx);
}
```
